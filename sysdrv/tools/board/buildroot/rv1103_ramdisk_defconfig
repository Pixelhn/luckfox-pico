## sysdrv/tools/board/buildroot/rv1103_ramdisk_defconfig
```kconfig
BR2_arm=y
BR2_cortex_a7=y
BR2_TOOLCHAIN_EXTERNAL=y
BR2_TOOLCHAIN_EXTERNAL_CUSTOM=y
BR2_TOOLCHAIN_EXTERNAL_PATH="../../../../tools/linux/toolchain/arm-rockchip830-linux-uclibcgnueabihf"
BR2_TOOLCHAIN_EXTERNAL_CUSTOM_PREFIX="arm-rockchip830-linux-uclibcgnueabihf"
BR2_TOOLCHAIN_EXTERNAL_GCC_8=y
BR2_TOOLCHAIN_EXTERNAL_HEADERS_5_10=y
BR2_TOOLCHAIN_EXTERNAL_WCHAR=y
BR2_TOOLCHAIN_EXTERNAL_HAS_SSP=y
BR2_TOOLCHAIN_EXTERNAL_CXX=y
BR2_PRIMARY_SITE="https://mirrors.nju.edu.cn/buildroot/"
BR2_OPTIMIZE_3=y
BR2_TARGET_GENERIC_HOSTNAME="ramdisk"
BR2_TARGET_GENERIC_ISSUE=""
BR2_TARGET_GENERIC_ROOT_PASSWD="root"
BR2_SYSTEM_ENABLE_NLS=y
BR2_PACKAGE_COREMARK=y
BR2_TARGET_ROOTFS_SQUASHFS=y
BR2_TARGET_ROOTFS_UBI=y
BR2_TARGET_ROOTFS_UBI_SUBSIZE=2048
BR2_TARGET_ROOTFS_UBIFS_LEBSIZE=0x1f000
BR2_TARGET_ROOTFS_UBIFS_MAXLEBCNT=624
BR2_TARGET_ROOTFS_UBIFS_OPTS="-F"
```

## sysdrv/tools/ramdisk/boot.its
```
/*
 * Copyright (C) 2021 Rockchip Electronics Co., Ltd
 *
 * SPDX-License-Identifier: GPL-2.0
 */

/dts-v1/;
/ {
    description = "FIT image with Linux kernel, FDT blob and resource";

    images {
        fdt {
            data = /incbin/("../../source/objs_kernel/out/fdt");
            type = "flat_dt";
            arch = "arm";
            compression = "none";
            load = <0xffffff00>;

            hash {
                algo = "sha256";
            };
        };

        kernel {
            data = /incbin/("../../source/objs_kernel/out/kernel");
            type = "kernel";
            arch = "arm";
            os = "linux";
            compression = "";
            entry = <0xffffff01>;
            load = <0xffffff01>;

            hash {
                algo = "sha256";
            };
        };

		ramdisk {
			data = /incbin/("../../source/buildroot/buildroot-2026.02.2/output/images/rootfs.squashfs");
			type = "ramdisk";
			arch = "arm";
			os = "linux";

            compression = "none";
		    load = <0xffffff02>;

			hash {
				algo = "sha256";
			};
		};

        resource {
            data = /incbin/("../../source/objs_kernel/out/resource");
            type = "multi";
            arch = "";
            compression = "none";

            hash {
                algo = "sha256";
            };
        };
    };

    configurations {
        default = "conf";

        conf {
            rollback-index = <0x00>;
            fdt = "fdt";
            kernel = "kernel";
            ramdisk = "ramdisk";
            multi = "resource";

            signature {
                algo = "sha256,rsa2048";
                padding = "pss";
                key-name-hint = "dev";
                sign-images = "fdt", "kernel", "ramdisk", "multi";
            };
        };
    };
};
```
